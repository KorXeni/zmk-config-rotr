## config/west.yml
```yaml
manifest:
  remotes:
    - name: zmkfirmware
      url-base: https://github.com/zmkfirmware
    - name: ftc
      url-base: https://github.com/ftc/zmk.git
  projects:
    - name: zmk
      remote: refil
      revision: rotrlayer
      import: app/west.yml
  self:
    path: config
```
